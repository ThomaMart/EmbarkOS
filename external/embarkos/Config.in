## external/embarkos/Config.in
```kconfig
source "$BR2_EXTERNAL_EMBARKOS_PATH/package/embark-info/Config.in"
source "$BR2_EXTERNAL_EMBARKOS_PATH/package/embark-uart/Config.in"
source "$BR2_EXTERNAL_EMBARKOS_PATH/package/embark-gpio/Config.in"
source "$BR2_EXTERNAL_EMBARKOS_PATH/package/embark-monitor/Config.in"
```

## external/embarkos/configs/embarkos_rpi3_defconfig
```kconfig
BR2_aarch64=y

BR2_TOOLCHAIN_BUILDROOT_GLIBC=y

BR2_LINUX_KERNEL=y

BR2_TARGET_GENERIC_HOSTNAME="embarkos"

BR2_TARGET_GENERIC_ISSUE="Welcome to EmbarkOS"

BR2_TARGET_GENERIC_GETTY_PORT="tty1"

BR2_TARGET_ROOTFS_EXT2=y

BR2_PACKAGE_BUSYBOX=y
```

## external/embarkos/package/embark-gpio/Config.in
```kconfig
config BR2_PACKAGE_EMBARK_GPIO
	bool "embark-gpio"
	depends on BR2_PACKAGE_LIBGPIOD
	help
	  EmbarkOS GPIO utility based on libgpiod.
```

## external/embarkos/package/embark-info/Config.in
```kconfig
config BR2_PACKAGE_EMBARK_INFO
    bool "embark-info"
    help
      Display EmbarkOS system information.
```

## external/embarkos/package/embark-monitor/Config.in
```kconfig
config BR2_PACKAGE_EMBARK_MONITOR
	bool "embark-monitor"
	help
	  EmbarkOS package monitor.
```

## external/embarkos/package/embark-uart/Config.in
```kconfig
config BR2_PACKAGE_EMBARK_UART
	bool "embark-uart"
	help
	  UART monitoring utility for embedded Linux.
```

## external/embarkos/templates/package/Config.in
```kconfig
config BR2_PACKAGE_EMBARK_TEMPLATE
	bool "embark-template"
	help
	  EmbarkOS package template.
```
